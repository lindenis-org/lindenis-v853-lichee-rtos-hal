## hal/source/vin/Kconfig
```kconfig
menu "VIN Devices"

config DRIVERS_VIN
    bool "enable vin driver"
    default n

if DRIVERS_VIN
choice
	depends on DRIVERS_VIN
	prompt "select isp work mode"
	default ISP_READ_THRESHOLD

config ISP_FAST_CONVERGENCE
	bool "use HFR to make AE&AWB fast stability"

config ISP_READ_THRESHOLD
	bool "read ae threshold from flash"
endchoice

config ISP_NUMBER
	int "isp support number"
	default 1
	range 1 2

endif

endmenu
```
